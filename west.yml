## west.yml
```yaml
manifest:
  defaults:
    remote: upstream

  remotes:
    - name: upstream
      url-base: https://github.com/zephyrproject-rtos

  projects:
    - name: cmsis
      revision: 74981bf893e8b10931464b9945e2143d99a3f0a3
      path: modules/hal/cmsis
      groups:
        - hal
    - name: hal_stm32
      revision: b916f9a01c665194fbbdd6a67a0f37b4e0a7e78c
      path: modules/hal/stm32
      groups:
        - hal
    - name: zephyr
      revision: e9a59518fcbd54f2ee27ea3f190a8fe7bd688f35
      path: zephyr
      west-commands: scripts/west-commands.yml
```
